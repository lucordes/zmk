/*
 * Copyright (c) 2020 The ZMK Contributors
 *
 * SPDX-License-Identifier: MIT
 */

#include <dt-bindings/zmk/matrix-transform.h>

/ {
	chosen {
		zmk,kscan = &kscan0;
	};

  kscan0: kscan_0 {
      compatible = "zmk,kscan-gpio-matrix";
      label = "KSCAN";
      diode-direction = "col2row";

      col-gpios
          = <&gpio0 29 GPIO_ACTIVE_HIGH>
          , <&gpio1 13 GPIO_ACTIVE_HIGH>
          , <&gpio0 10 GPIO_ACTIVE_HIGH>
          , <&gpio0 31 GPIO_ACTIVE_HIGH>
          , <&gpio1 15 GPIO_ACTIVE_HIGH>
          , <&gpio0 9 GPIO_ACTIVE_HIGH>
          , <&gpio1 11 GPIO_ACTIVE_HIGH>
          , <&gpio1 1 GPIO_ACTIVE_HIGH>
          , <&gpio0 22 GPIO_ACTIVE_HIGH>
          , <&gpio0 17 GPIO_ACTIVE_HIGH>
          , <&gpio0 11 GPIO_ACTIVE_HIGH>
          , <&gpio1 0 GPIO_ACTIVE_HIGH>
          ;

      row-gpios
          = <&gpio0 20 (GPIO_ACTIVE_HIGH | GPIO_PULL_DOWN)>
          , <&gpio1 4 (GPIO_ACTIVE_HIGH | GPIO_PULL_DOWN)>
          , <&gpio1 6 (GPIO_ACTIVE_HIGH | GPIO_PULL_DOWN)>
          , <&gpio0 24 (GPIO_ACTIVE_HIGH | GPIO_PULL_DOWN)>
          ;
  };
};
//029,113,010,031,115,009,111,101,022,0.17,011,100
//020,104,106,024
